## dts/bindings/input_processors/zmk,input-processor-behavior-trigger.yaml
```yaml
# Copyright (c) 2026
# SPDX-License-Identifier: MIT

description: Input processor that invokes behaviors for matched events

compatible: "zmk,input-processor-behavior-trigger"

include: ip_zero_param.yaml

properties:
  type:
    type: int
  codes:
    type: array
    required: true
  bindings:
    type: phandle-array
    required: true
  timeout-ms:
    type: int
    description: Delay after the last matching event before invoking timeout-bindings.
  timeout-bindings:
    type: phandle-array
    description: Behavior invoked after timeout-ms has elapsed since the last matching event.
```

## dts/bindings/input_processors/zmk,input-processor-layer-timeout.yaml
```yaml
# Copyright (c) 2026
# SPDX-License-Identifier: MIT

description: Input processor that switches to a layer and returns after inactivity

compatible: "zmk,input-processor-layer-timeout"

include: ip_zero_param.yaml

properties:
  type:
    type: int
  codes:
    type: array
    required: true
  layer:
    type: int
    required: true
    description: Layer selected when a matching input event is observed.
  timeout-ms:
    type: int
    required: true
    description: Delay after the last matching event before selecting timeout-layer.
  timeout-layer:
    type: int
    required: true
    description: Layer selected after timeout-ms has elapsed.
```

## tests/iqs9151_work_cb/testcase.yaml
```yaml
tests:
  iqs9151.scroll_pipeline:
    tags: [iqs9151, input]
    platform_allow: [native_sim_64]
    extra_args: IQS_SCROLL_PIPELINE=1
  iqs9151.work_cb:
    tags:
      - iqs9151
      - input
    platform_allow:
      - native_sim
      - native_sim_64
  iqs9151.gestures.disabled:
    tags: [iqs9151, input]
    platform_allow: [native_sim_64]
    extra_args: IQS_GESTURE_MATRIX=0

  iqs9151.gestures.scroll:
    tags: [iqs9151, input]
    platform_allow: [native_sim_64]
    extra_args: IQS_GESTURE_MATRIX=1

  iqs9151.gestures.action:
    tags: [iqs9151, input]
    platform_allow: [native_sim_64]
    extra_args: IQS_GESTURE_MATRIX=2
```
